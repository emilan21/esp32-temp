## main/Kconfig.projbuild
```kconfig
menu "Room Sensor Config"

	orsource "$IDF_PATH/examples/common_components/env_caps/$IDF_TARGET/Kconfig.env_caps"

	config DHT11_GPIO
		int "DHT11 data GPIO"
		range ENV_GPIO_RANGE_MIN ENV_GPIO_RANGE_MAX
		default 5
		help
			GPIO used for DHT11 data pin.

	config STATUS_LED_GPIO
		int "Status LED GPIO"
		range ENV_GPIO_RANGE_MIN ENV_GPIO_RANGE_MAX
		default 2
		help
			GPIO used for status led pin.
endmenu

menu "Wifi Config"

config ESP_WIFI_SSID
	string "WIFI SSID"
	default "myssid"
	help
		SSID (network name) for the esp32 to connect to.

config ESP_WIFI_PASSWORD
	string "WIFI PASSWORD"
	default "mypassword"
	help
		SSID (network name) for the esp32 to connect to.

choice ESP_WIFI_SAE_MODE
	prompt "WPA3 SAE mode selection"
	default ESP_STATION_WPA3_SAE_PWE_BOTH
	help
		Select mode for SAE as Hunt and Peck, H2E, or both.
	config ESP_STATION_WPA3_SAE_PWE_HUNT_AND_PECK
		bool "HUNT AND PECK"
	config ESP_STATION_WPA3_SAE_PWE_HASH_TO_ELEMENT
		bool "H2E"
		depends on ESP_WIFI_ENABLE_SAE_H2E
	config ESP_STATION_WPA3_SAE_PWE_BOTH
		bool "BOTH"
		depends on ESP_WIFI_ENABLE_SAE_H2E
endchoice

config ESP_WIFI_PW_ID
	string "PASSWORD IDENTIFIER"
	depends on ESP_STATION_WPA3_SAE_PWE_HASH_TO_ELEMENT || ESP_STATION_WPA3_SAE_PWE_BOTH
	default ""
	help
		password identifier for SAE H2E

config ESP_WIFI_MAXIMUM_RETRY
	int "Maximum retry"
	default "5"
	help
		Set the Maxiumum retry to avoid station reconnecting to the AP ulimited when the AP is really inexistent..

choice ESP_WIFI_SCAN_AUTH_MODE_THRESHOLD
	prompt "WIFI Scan auth mode threshold"
	default ESP_WIFI_AUTH_WPA2_PSK
	help
		The weakest automode to accept in scan mode.
		This value defualts to ESP_WIFI_AUTH_WPA2_PSK in case password is present and ESP_WIFI_AUTH_OPEN is used.
		Please select ESP_WIFI_AUTH_WEP/ESP_WIFI_AUTH_WPA_PSK in case AP is operating in WEP/WPA mode.

	config ESP_WIFI_AUTH_OPEN
		bool "OPEN"
	config ESP_WIFI_AUTH_WEP
		bool "WEP"
	config ESP_WIFI_AUTH_WPA_PSK
		bool "WPA PSK"
	config ESP_WIFI_AUTH_WPA2_PSK
		bool "WPA2 PSK"
	config ESP_WIFI_AUTH_WPA_WPA2_PSK
		bool "WPA/WPA2 PSK"
	config ESP_WIFI_AUTH_WPA3_PSK
		bool "WPA3 PSK"
	config ESP_WIFI_AUTH_WPA2_WPA3_PSK
		bool "WPA2/WPA3 PSK"
	config ESP_WIFI_AUTH_WAPI_PSK
		bool "WAPI PSK"
endchoice

endmenu

menu "HTTP Client Configuration"
	config HTTP_ENDPOINT
		string "HTTP Endpoint"
		default "example.com"
		help
			Target endpoint host-name to use
	
	config ENABLE_RESPONSE_BUFFER_DUMP
	bool "Enable logging reponse buffer from HTTP even handler"
	default n
	help
		HTTP reponse is accumlated in output_buffer. Enable this config to print the accumulated response
endmenu
```
